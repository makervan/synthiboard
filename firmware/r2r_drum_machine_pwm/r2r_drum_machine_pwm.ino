// Arduino Drum Machine
// https://little-scale.blogspot.de/2013/05/diy-polyphonic-drum-machine-and-rhythm.html
// Ported over to Arduino
//
// R2R Reference: http://little-scale.blogspot.com.au/2013/05/teensy-basics-6-r2r-dac-primer.html
//
//
//                             D0   D1   RST
//              GND  GND  VCC  RX   TX   /DTR
//                +--------------------------------+
//                |  [ ]  [ ]  [ ]  [ ]  [ ]  [ ]  |
//                |              FTDI              |
//            D1  | [ ]1/TX                 RAW[ ] |    
//            D0  | [ ]0/RX                 GND[ ] |    
//                | [ ]RST        SCL/A5[ ] RST[ ] |   C6
// GND            | [ ]GND        SDA/A4[ ] VCC[ ] |          - VCC
//.           D2  | [ ]2/INT0    ___         A3[ ] |   C3
// Audio      D3  |~[ ]3/INT1   /   \        A2[ ] |   C2
//            D4  | [ ]4       /PRO  \       A1[ ] |   C1
//            D5  |~[ ]5       \ MINI/       A0[ ] |   C0     - 10k Pot
//            D6  |~[ ]6        \___/    SCK/13[ ] |   B5     - LED
//            D7  | [ ]7          A7[ ] MISO/12[ ] |   B4     - Button 4
//            B0  | [ ]8          A6[ ] MOSI/11[ ]~|   B3     - Button 3
// Button 1 - B1  |~[ ]9                  SS/10[ ]~|   B2     - Button 2
//                |           [RST-BTN]            |    
//                +--------------------------------+  
//   Source:  http://busyducks.com/ascii-art-arduinos
//
//                    +10µF 
//PIN 03 ---[ 1k ]--+---||--->> Audio out
//                  |
//                 === 10nF
//                  |
//                 GND
//https://github.com/dzlonline/the_synth/blob/master/the_synth/examples/modulation/modulation.ino

const byte sound[] PROGMEM = {
    31, 31, 31, 29, 27, 35, 49, 37, 10, 11, 21, 32,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 17

  , 31, 31, 31, 32, 32, 28, 24, 32, 42, 37, 27, 24,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 31

  , 31, 31, 31, 32, 33, 30, 21, 17, 38, 61, 51, 31,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 31
  
  , 31, 31, 31, 31, 30, 31, 34, 34, 30, 28, 26, 27,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 28
};



byte sound_pattern[64];

byte button_previous[4]; 

void setup() {
  pinMode(3,OUTPUT);

  TCCR2A = _BV(COM2A1) | _BV(COM2B1) | _BV(WGM20);
  TCCR2B = _BV(CS20);
  
  pinMode(4, INPUT_PULLUP);
  pinMode(5, INPUT_PULLUP);
  pinMode(6, INPUT_PULLUP);
  pinMode(7, INPUT_PULLUP);
  pinMode(13, OUTPUT); 
  digitalWrite(13, HIGH);
}

void loop() {
  int takte = (analogRead(1) >> 6) + 1;
  for(int j = 0; j < takte; j ++) {
    
  // start playing a subdivsion
  // blink LED
  digitalWrite(13, 3 - (j % 4));
  
  // get pot value and set sampling rate for sample playback
  int sample_rate = (analogRead(0) >> 3) + 2;  
  int crush = 1;//(analogRead(1) >> 5) + 1;

  takte = 16;//(analogRead(1) >> 6) + 1; 
  
  // read buttons
  for(int k = 0; k < 4; k ++) {
    byte button_data = digitalRead(k + 4); 
    if(button_data != button_previous[k]) {
      button_previous[k] = button_data;
      if(button_data == 0) {
      sound_pattern[k * 16 + j] = 1;
      }
    }
  }
  
  // sample_playback
  for(int i = 0; i < 5000; i+= crush ) {
    // get sample data 
    byte data_1 = sound_pattern[j + 0] * pgm_read_byte_near(sound + i + 0); 
    byte data_2 = sound_pattern[j + 16] * pgm_read_byte_near(sound + i + 5000); 
    byte data_3 = sound_pattern[j + 32] * pgm_read_byte_near(sound + i + 10000); 
    byte data_4 = sound_pattern[j + 48] * pgm_read_byte_near(sound + i + 15000); 
    // write sample data to port
    //PORTD = data_1 + data_2 + data_3 + data_4; 
    OCR2B = data_1 + data_2 + data_3 + data_4;
    delayMicroseconds(sample_rate);
  
  }
  }
}
